## block/blk/Kconfig
```kconfig
# SPDX-License-Identifier: GPL-2.0-only
# Copyright (C) 2018-2021 Oplus. All rights reserved.

config OPLUS_BLK_MONITOR
	bool "block layer monitor "
	default n
	help
	 block layer monitor.
```

## drivers/soc/Kconfig
```kconfig
menu "SOC (System On Chip) specific Drivers"

source "drivers/soc/actions/Kconfig"
source "drivers/soc/amlogic/Kconfig"
source "drivers/soc/atmel/Kconfig"
source "drivers/soc/bcm/Kconfig"
source "drivers/soc/fsl/Kconfig"
source "drivers/soc/imx/Kconfig"
source "drivers/soc/mediatek/Kconfig"
source "drivers/soc/qcom/Kconfig"
source "drivers/soc/renesas/Kconfig"
source "drivers/soc/rockchip/Kconfig"
source "drivers/soc/samsung/Kconfig"
source "drivers/soc/sunxi/Kconfig"
source "drivers/soc/tegra/Kconfig"
source "drivers/soc/ti/Kconfig"
source "drivers/soc/ux500/Kconfig"
source "drivers/soc/versatile/Kconfig"
source "drivers/soc/xilinx/Kconfig"
source "drivers/soc/zte/Kconfig"

if OPLUS_KERNEL
source "drivers/soc/oplus/Kconfig"
source "drivers/soc/oplus/iomonitor/Kconfig"
source "drivers/soc/oplus/healthinfo/Kconfig"
source "drivers/soc/oplus/tpp/Kconfig"
source "drivers/soc/oplus/im/Kconfig"
source "drivers/soc/oplus/tpd/Kconfig"
source "drivers/soc/oplus/game_opt/Kconfig"
source "drivers/soc/oplus/oplus_overload/Kconfig"
endif

endmenu
```

## drivers/soc/oplus/Kconfig
```kconfig
# SPDX-License-Identifier: GPL-2.0-only
# Copyright (C) 2018-2021 Oplus. All rights reserved.

source "drivers/soc/oplus/lowmem_dbg/Kconfig"
source "drivers/soc/oplus/svelte/Kconfig"
```

## drivers/soc/oplus/game_opt/Kconfig
```kconfig
# SPDX-License-Identifier: GPL-2.0-only
# Copyright (C) 2018-2021 Oplus. All rights reserved.

config OPLUS_FEATURE_GAME_OPT
        tristate "game optimization"
        default n
        help
            game optimization support
```

## drivers/soc/oplus/healthinfo/Kconfig
```kconfig
# SPDX-License-Identifier: GPL-2.0-only
# Copyright (C) 2018-2021 Oplus. All rights reserved.

config OPLUS_HEALTHINFO
bool "config healthinfo"
help
    define this config to init  healthinfo.

config MMAP_LOCK_OPT
	bool "config mmap lock opt boos"
	default n
	help
	  reduce sleep time in mmap lock
```

## drivers/soc/oplus/iomonitor/Kconfig
```kconfig
# SPDX-License-Identifier: GPL-2.0-only
# Copyright (C) 2018-2021 Oplus. All rights reserved.

config IOMONITOR
	bool "Iomonitor module"
	help
		define this config to init iomonitor.

config IOMONITOR_WITH_F2FS
	bool "Filesystem is f2fs"
	depends on IOMONITOR
	help
		define this config to support both f2fs and ext4
```

## drivers/soc/oplus/midas/Kconfig
```kconfig
# SPDX-License-Identifier: GPL-2.0-only
# Copyright (C) 2018-2020 Oplus. All rights reserved.

config OPLUS_FEATURE_BINDER_STATS_ENABLE
bool "config oplus midas binder stats feature"
help
	This selects midas binder stats device driver
```

## drivers/soc/oplus/oplus_nandswap/Kconfig
```kconfig
config NANDSWAP
	bool "nandswap feature"
	default y
	help
	 nandswap feature

config NANDSWAP_DEBUG
	bool "nandswap debug"
	depends on F2FS_FS
	default n
	help
	 nandswap debug
```

## drivers/soc/oplus/oplus_overload/Kconfig
```kconfig
# SPDX-License-Identifier: GPL-2.0-only
# Copyright (C) 2018-2021 Oplus. All rights reserved.

config OPLUS_FEATURE_ABNORMAL_FLAG
	tristate "abnormal_flag"
	default n
	help
	  abnormal thread detection
```

## fs/nomount/Kconfig
```kconfig
# Kconfig for NoMount

config NOMOUNT
	tristate "NoMount Path Redirection Subsystem"
	help
	  NoMount allows path redirection and virtual file injection
	  without mounting filesystems. Useful for systemless modifications.
```

## fs/proc/sched_info/Kconfig
```kconfig
# SPDX-License-Identifier: GPL-2.0-only
# Copyright (C) 2018-2021 Oplus. All rights reserved.

config OPLUS_FEATURE_CPU_JANKINFO
	tristate "config cpu_jankinfo"
	default n
	help
	  define this config to enable cpu jankinfo.
```

## fs/proc/task_cpustats/Kconfig
```kconfig
# SPDX-License-Identifier: GPL-2.0-only
# Copyright (C) 2018-2021 Oplus. All rights reserved.

config OPLUS_CTP
	tristate "task_cpustats"
	default n
	help
	  record cpu status

config OPLUS_SCHED
	tristate "task_sched_info"
	default n
	help
	  record task sched info

config UTILS_MONITOR
        tristate "task_load"
        default n
        help
          record task load

config OPLUS_GPU_FREQ_TRACE_POINT
	tristate "msm_kgsl"
	default n
	help
	  change kgsl gpu frequency trace point
```

## kernel/Kconfig
```kconfig
# SPDX-License-Identifier: GPL-2.0-only
# Copyright (C) 2018-2021 Oplus. All rights reserved.

source "kernel/sigkill_diagnosis/Kconfig"
source "kernel/sched_assist/Kconfig"
source "kernel/tuning/Kconfig"
source "kernel/uad/Kconfig"
```

## kernel/special_opt/Kconfig
```kconfig
# SPDX-License-Identifier: GPL-2.0-only
# Copyright (C) 2018-2021 Oplus. All rights reserved.

config OPLUS_FEATURE_UIFRIST_HEAVYLOAD
	tristate "cpu sched for heavy load process"
	default y
	help
	  cpu sched for heavy load process.
```

## kernel/tuning/Kconfig
```kconfig
# SPDX-License-Identifier: GPL-2.0-only
# Copyright (C) 2018-2021 Oplus. All rights reserved.

config OPLUS_FEATURE_FRAME_BOOST
	bool "config frame boost3.0"
	default n
	depends on SCHED_WALT
	help
		track key thread information during frame drawing, opt task placement and frequency selection
```

## mm/dynamic_readhead/Kconfig
```kconfig
# SPDX-License-Identifier: GPL-2.0-only
# Copyright (C) 2018-2021 Oplus. All rights reserved.

config OPLUS_DYNAMIC_READAHEAD
	bool "dynamic page fault read-ahead size"
	depends on OPLUS_FEATURE_SCHED_ASSIST && FG_TASK_UID
	default n
	help
	  This feature dynamically set read-ahead size for performance.
```

## mm/healthinfo/Kconfig
```kconfig
# SPDX-License-Identifier: GPL-2.0-only
# Copyright (C) 2018-2021 Oplus. All rights reserved.

config OPLUS_MEM_MONITOR
	bool "memory monitor "
	default n
	help
	 memory monitor.
```

## mm/multi_freearea/Kconfig
```kconfig
# SPDX-License-Identifier: GPL-2.0-only
# Copyright (C) 2018-2021 Oplus. All rights reserved.

config PHYSICAL_ANTI_FRAGMENTATION
	bool "Physical memory anti-fragmentation"
	default n
	help
	 Turn on the function of Physical memory anti-fragmentation.
```

## mm/oplus/Kconfig
```kconfig
# SPDX-License-Identifier: GPL-2.0-only
# Copyright (C) 2018-2021 Oplus. All rights reserved.

config KSHRINK_SLABD
	bool "enable async shrink_lruvecd"
	default n
	help
	  enable async shrink_lruvecd

config SHRINK_LRU_TRYLOCK
	bool "enable async shrink_lruvecd"
	default n
	help
	  enable async shrink_lruvecd

config MAPPED_PROTECT
	bool "mapped protect"
	default n
	help
	  protect multi-mapped pages
```

## mm/proactive_compact/Kconfig
```kconfig
# SPDX-License-Identifier: GPL-2.0-only
# Copyright (C) 2018-2021 Oplus. All rights reserved.

config PROACTIVE_COMPACT
	tristate "trigger memory compact based on fragmentation index"
	default n
	help
	  trigger memory compact based on fragmentation index
```

## mm/process_mm_reclaim/Kconfig
```kconfig
# SPDX-License-Identifier: GPL-2.0-only
# Copyright (C) 2018-2021 Oplus. All rights reserved.
config PROCESS_RECLAIM_ENHANCE
	bool "Enable process reclaim enchance"
	depends on PROCESS_RECLAIM
	default n
	help
	 It allows to reclaim different type pages of the process by
	 /proc/process_reclaim.

	 (echo inactive_file > /proc/PID/reclaim) reclaims inactive file-backed
		pages only.
	 (echo inactive_anon > /proc/PID/reclaim) reclaims inactive anonymous
		pages only.
	 (echo inactive > /proc/PID/reclaim) reclaims inactive file-backed and
		anonymous pages only.
	 Any other vaule, please reference PROCESS_RECLAIM.
```

## mm/reserve_area/Kconfig
```kconfig
# SPDX-License-Identifier: GPL-2.0-only
# Copyright (C) 2018-2021 Oplus. All rights reserved.

config VIRTUAL_RESERVE_MEMORY
	bool "reserved vma for gpu emergency mmap"
	default n
	help
	 support reserved vma for gpu emergency mmap.
```

## mm/uxmem_opt/Kconfig
```kconfig
# SPDX-License-Identifier: GPL-2.0-only
# Copyright (C) 2018-2021 Oplus. All rights reserved.

config OPLUS_UXMEM_OPT
        bool "enable uxmem_opt"
        depends on OPLUS_FEATURE_SCHED_ASSIST && FG_TASK_UID
        default n
        help
          enable uxmem_opt
```

## net/oplus_dhcp/Kconfig
```kconfig
# SPDX-License-Identifier: GPL-2.0-only
# Copyright (C) 2020-2022 Oplus. All rights reserved.

config OPLUS_FEATURE_DHCP
	tristate "Add for oplus dhcp function"
	help
	  Add for oplus dhcp function.
```

## net/oplus_nf_hooks/Kconfig
```kconfig
# SPDX-License-Identifier: GPL-2.0-only
# Copyright (C) 2020-2022 Oplus. All rights reserved.

config OPLUS_FEATURE_WIFI_LUCKYMONEY
	tristate "Add for oplus lucky money"
	help
	  Add for oplus lucky money.
```
