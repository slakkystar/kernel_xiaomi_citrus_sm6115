&mdss_mdp {
	dsi_nt36525_truly_video: qcom,mdss_dsi_nt36525_truly_video {
		qcom,mdss-dsi-panel-name = "nt36525 video mode dsi truly panel";
		qcom,mdss-dsi-panel-type = "dsi_video_mode";
		qcom,dsi-ctrl-num = <0>;
		qcom,dsi-phy-num = <0>;
		qcom,mdss-dsi-virtual-channel-id = <0>;
		qcom,mdss-dsi-stream = <0>;
		qcom,mdss-dsi-h-left-border = <0>;
		qcom,mdss-dsi-h-right-border = <0>;
		qcom,mdss-dsi-v-top-border = <0>;
		qcom,mdss-dsi-v-bottom-border = <0>;
		qcom,mdss-dsi-bpp = <24>;
		qcom,mdss-dsi-color-order = "rgb_swap_rgb";
		qcom,mdss-dsi-underflow-color = <0xff>;
		qcom,mdss-dsi-border-color = <0>;
		qcom,mdss-dsi-h-sync-pulse = <0>;
		qcom,mdss-dsi-traffic-mode = "non_burst_sync_event";
		qcom,mdss-dsi-lane-map = "lane_map_0123";
		qcom,mdss-dsi-bllp-eof-power-mode;
		qcom,mdss-dsi-bllp-power-mode;
		qcom,mdss-dsi-tx-eot-append;
		qcom,mdss-dsi-lane-0-state;
		qcom,mdss-dsi-lane-1-state;
		qcom,mdss-dsi-lane-2-state;
		qcom,mdss-dsi-lane-3-state;
		qcom,mdss-dsi-dma-trigger = "trigger_sw";
		qcom,mdss-dsi-mdp-trigger = "none";
		qcom,mdss-dsi-lp11-init;
		qcom,mdss-dsi-bl-pmic-control-type = "bl_ctrl_wled";
		qcom,mdss-dsi-bl-min-level = <1>;
		qcom,mdss-dsi-bl-max-level = <4095>;
		qcom,mdss-dsi-reset-sequence = <1 10>, <0 10>, <1 10>;
		qcom,mdss-pan-physical-width-dimension = <65>;
		qcom,mdss-pan-physical-height-dimension = <129>;
		qcom,mdss-dsi-t-clk-post = <0x0a>;
		qcom,mdss-dsi-t-clk-pre = <0x21>;
		qcom,dsi-select-clocks = "mux_byte_clk0", "mux_pixel_clk0",
					  "src_byte_clk0", "src_pixel_clk0",
					  "shadow_byte_clk0", "shadow_pixel_clk0";

		qcom,mdss-dsi-display-timings {
			timing@0 {
				qcom,mdss-dsi-panel-width = <720>;
				qcom,mdss-dsi-panel-height = <1520>;
				qcom,mdss-dsi-h-front-porch = <80>;
				qcom,mdss-dsi-h-back-porch = <88>;
				qcom,mdss-dsi-h-pulse-width = <20>;
				qcom,mdss-dsi-h-sync-skew = <0>;
				qcom,mdss-dsi-v-back-porch = <4>;
				qcom,mdss-dsi-v-front-porch = <8>;
				qcom,mdss-dsi-v-pulse-width = <4>;
				qcom,mdss-dsi-panel-framerate = <60>;
				qcom,mdss-dsi-on-command = [
					15 01 00 00 00 00 02 ff 20
					15 01 00 00 00 00 02 fb 01
					15 01 00 00 00 00 02 05 a9
					15 01 00 00 00 00 02 07 73
					15 01 00 00 00 00 02 08 c1
					15 01 00 00 00 00 02 0e 87
					15 01 00 00 00 00 02 0f 55
					15 01 00 00 00 00 02 1f 00
					15 01 00 00 00 00 02 69 a9
					15 01 00 00 00 00 02 6d 33
					15 01 00 00 00 00 02 89 64
					15 01 00 00 00 00 02 8a 64
					15 01 00 00 00 00 02 8b 64
					15 01 00 00 00 00 02 8c 64
					15 01 00 00 00 00 02 95 eb
					15 01 00 00 00 00 02 96 eb
					15 01 00 00 00 00 02 ff 23
					15 01 00 00 00 00 02 fb 01
					15 01 00 00 00 00 02 12 ab
					15 01 00 00 00 00 02 15 f5
					15 01 00 00 00 00 02 16 0b
					15 01 00 00 00 00 02 ff 24
					15 01 00 00 00 00 02 fb 01
					15 01 00 00 00 00 02 02 05
					15 01 00 00 00 00 02 03 05
					15 01 00 00 00 00 02 04 9f
					15 01 00 00 00 00 02 05 9f
					15 01 00 00 00 00 02 06 9e
					15 01 00 00 00 00 02 07 9e
					15 01 00 00 00 00 02 08 0c
					15 01 00 00 00 00 02 09 03
					15 01 00 00 00 00 02 0a 0d
					15 01 00 00 00 00 02 0b 0e
					15 01 00 00 00 00 02 0c 0f
					15 01 00 00 00 00 02 0d 10
					15 01 00 00 00 00 02 0e 11
					15 01 00 00 00 00 02 0f 12
					15 01 00 00 00 00 02 10 13
					15 01 00 00 00 00 02 11 04
					15 01 00 00 00 00 02 12 04
					15 01 00 00 00 00 02 18 05
					15 01 00 00 00 00 02 19 05
					15 01 00 00 00 00 02 1a 9f
					15 01 00 00 00 00 02 1b 9f
					15 01 00 00 00 00 02 1c 9e
					15 01 00 00 00 00 02 1d 9e
					15 01 00 00 00 00 02 1e 0c
					15 01 00 00 00 00 02 1f 03
					15 01 00 00 00 00 02 20 0d
					15 01 00 00 00 00 02 21 0e
					15 01 00 00 00 00 02 22 0f
					15 01 00 00 00 00 02 23 10
					15 01 00 00 00 00 02 24 11
					15 01 00 00 00 00 02 25 12
					15 01 00 00 00 00 02 26 13
					15 01 00 00 00 00 02 27 04
					15 01 00 00 00 00 02 28 04
					15 01 00 00 00 00 02 2f 0c
					15 01 00 00 00 00 02 30 40
					15 01 00 00 00 00 02 33 40
					15 01 00 00 00 00 02 34 0c
					15 01 00 00 00 00 02 37 77
					15 01 00 00 00 00 02 3a 9a
					15 01 00 00 00 00 02 3b 95
					15 01 00 00 00 00 02 3d 92
					15 01 00 00 00 00 02 4d 15
					15 01 00 00 00 00 02 4e 26
					15 01 00 00 00 00 02 4f 37
					15 01 00 00 00 00 02 50 48
					15 01 00 00 00 00 02 51 84
					15 01 00 00 00 00 02 52 73
					15 01 00 00 00 00 02 53 62
					15 01 00 00 00 00 02 54 51
					15 01 00 00 00 00 02 55 86
					15 01 00 00 00 00 02 56 78
					15 01 00 00 00 00 02 5a 9a
					15 01 00 00 00 00 02 5b 95
					15 01 00 00 00 00 02 5c 8f
					15 01 00 00 00 00 02 5d 0a
					15 01 00 00 00 00 02 5e 10
					15 01 00 00 00 00 02 60 80
					15 01 00 00 00 00 02 61 7c
					15 01 00 00 00 00 02 64 11
					15 01 00 00 00 00 02 85 11
					15 01 00 00 00 00 02 92 ad
					15 01 00 00 00 00 02 93 08
					15 01 00 00 00 00 02 94 06
					15 01 00 00 00 00 02 ab 00
					15 01 00 00 00 00 02 ad 00
					15 01 00 00 00 00 02 b0 05
					15 01 00 00 00 00 02 b1 a9
					15 01 00 00 00 00 02 ff 25
					15 01 00 00 00 00 02 fb 01
					15 01 00 00 00 00 02 0a 82
					15 01 00 00 00 00 02 0b 9c
					15 01 00 00 00 00 02 0c 01
					15 01 00 00 00 00 02 17 82
					15 01 00 00 00 00 02 18 06
					15 01 00 00 00 00 02 19 0f
					15 01 00 00 00 00 02 1f 9a
					15 01 00 00 00 00 02 20 95
					15 01 00 00 00 00 02 23 05
					15 01 00 00 00 00 02 24 a9
					15 01 00 00 00 00 02 26 9a
					15 01 00 00 00 00 02 27 95
					15 01 00 00 00 00 02 2a 05
					15 01 00 00 00 00 02 2b a9
					15 01 00 00 00 00 02 2f 80
					15 01 00 00 00 00 02 40 10
					15 01 00 00 00 00 02 41 80
					15 01 00 00 00 00 02 42 a6
					15 01 00 00 00 00 02 43 95
					15 01 00 00 00 00 02 46 05
					15 01 00 00 00 00 02 47 a9
					15 01 00 00 00 00 02 4c 95
					15 01 00 00 00 00 02 4e 95
					15 01 00 00 00 00 02 4f a6
					15 01 00 00 00 00 02 50 95
					15 01 00 00 00 00 02 53 05
					15 01 00 00 00 00 02 54 a9
					15 01 00 00 00 00 02 55 05
					15 01 00 00 00 00 02 56 a9
					15 01 00 00 00 00 02 5a 80
					15 01 00 00 00 00 02 5b 80
					15 01 00 00 00 00 02 5d 9a
					15 01 00 00 00 00 02 5e 95
					15 01 00 00 00 00 02 5f 9a
					15 01 00 00 00 00 02 60 95
					15 01 00 00 00 00 02 61 9a
					15 01 00 00 00 00 02 62 95
					15 01 00 00 00 00 02 65 05
					15 01 00 00 00 00 02 66 a9
					15 01 00 00 00 00 02 ff 26
					15 01 00 00 00 00 02 fb 01
					15 01 00 00 00 00 02 04 42
					15 01 00 00 00 00 02 06 ff
					15 01 00 00 00 00 02 0c 0b
					15 01 00 00 00 00 02 0d 01
					15 01 00 00 00 00 02 0e 02
					15 01 00 00 00 00 02 0f 06
					15 01 00 00 00 00 02 10 07
					15 01 00 00 00 00 02 13 24
					15 01 00 00 00 00 02 14 88
					15 01 00 00 00 00 02 16 81
					15 01 00 00 00 00 02 19 15
					15 01 00 00 00 00 02 1a 0d
					15 01 00 00 00 00 02 1b 12
					15 01 00 00 00 00 02 1c 82
					15 01 00 00 00 00 02 1e ad
					15 01 00 00 00 00 02 1f ad
					15 01 00 00 00 00 02 24 00
					15 01 00 00 00 00 02 2f 04
					15 01 00 00 00 00 02 30 ad
					15 01 00 00 00 00 02 31 11
					15 01 00 00 00 00 02 32 11
					15 01 00 00 00 00 02 34 04
					15 01 00 00 00 00 02 35 ad
					15 01 00 00 00 00 02 36 81
					15 01 00 00 00 00 02 37 67
					15 01 00 00 00 00 02 38 11
					15 01 00 00 00 00 02 3f 10
					15 01 00 00 00 00 02 40 ad
					15 01 00 00 00 00 02 58 d6
					15 01 00 00 00 00 02 59 d6
					15 01 00 00 00 00 02 5a d6
					15 01 00 00 00 00 02 5b ad
					15 01 00 00 00 00 02 5c 00
					15 01 00 00 00 00 02 5d 26
					15 01 00 00 00 00 02 5e 10
					15 01 00 00 00 00 02 63 9a
					15 01 00 00 00 00 02 64 95
					15 01 00 00 00 00 02 65 9a
					15 01 00 00 00 00 02 66 95
					15 01 00 00 00 00 02 67 9a
					15 01 00 00 00 00 02 68 95
					15 01 00 00 00 00 02 6b 00
					15 01 00 00 00 00 02 6d 00
					15 01 00 00 00 00 02 70 05
					15 01 00 00 00 00 02 71 d2
					15 01 00 00 00 00 02 73 9a
					15 01 00 00 00 00 02 74 95
					15 01 00 00 00 00 02 77 05
					15 01 00 00 00 00 02 78 d2
					15 01 00 00 00 00 02 7a 9a
					15 01 00 00 00 00 02 7b 95
					15 01 00 00 00 00 02 7e 05
					15 01 00 00 00 00 02 7f d2
					15 01 00 00 00 00 02 82 9a
					15 01 00 00 00 00 02 83 95
					15 01 00 00 00 00 02 84 9a
					15 01 00 00 00 00 02 85 95
					15 01 00 00 00 00 02 86 9a
					15 01 00 00 00 00 02 87 95
					15 01 00 00 00 00 02 8a 05
					15 01 00 00 00 00 02 8b a9
					15 01 00 00 00 00 02 8f 00
					15 01 00 00 00 00 02 90 00
					15 01 00 00 00 00 02 92 05
					15 01 00 00 00 00 02 93 f0
					15 01 00 00 00 00 02 99 0d
					15 01 00 00 00 00 02 9a 36
					15 01 00 00 00 00 02 9b 0c
					15 01 00 00 00 00 02 9c 9e
					15 01 00 00 00 00 02 ff 27
					15 01 00 00 00 00 02 fb 01
					15 01 00 00 00 00 02 13 00
					15 01 00 00 00 00 02 14 55
					15 01 00 00 00 00 02 ff 27
					15 01 00 00 00 00 02 fb 01
					15 01 00 00 00 00 02 9e 00
					15 01 00 00 00 00 02 ff 20
					15 01 00 00 00 00 02 fb 01
					29 01 00 00 00 00 11 b0 00 00 00 2e 00 65 00 8c 00 aa 00 c4 00 da 00 ed
					29 01 00 00 00 00 11 b1 00 fe 01 36 01 5c 01 99 01 c3 02 03 02 33 02 34
					29 01 00 00 00 00 11 b2 02 64 02 98 02 c0 02 f1 03 10 03 47 03 53 03 64
					29 01 00 00 00 00 0d b3 03 76 03 8c 03 a6 03 c3 03 d9 03 ff
					29 01 00 00 00 00 11 b4 00 00 00 2e 00 65 00 8c 00 aa 00 c4 00 da 00 ed
					29 01 00 00 00 00 11 b5 00 fe 01 36 01 5c 01 99 01 c3 02 03 02 33 02 34
					29 01 00 00 00 00 11 b6 02 64 02 98 02 c0 02 f1 03 10 03 47 03 53 03 64
					29 01 00 00 00 00 0d b7 03 76 03 8c 03 a6 03 c3 03 d9 03 ff
					29 01 00 00 00 00 11 b8 00 00 00 2e 00 65 00 8c 00 aa 00 c4 00 da 00 ed
					29 01 00 00 00 00 11 b9 00 fe 01 36 01 5c 01 99 01 c3 02 03 02 33 02 34
					29 01 00 00 00 00 11 ba 02 64 02 98 02 c0 02 f1 03 10 03 47 03 53 03 64
					29 01 00 00 00 00 0d bb 03 76 03 8c 03 a6 03 c3 03 d9 03 ff
					15 01 00 00 00 00 02 ff 21
					15 01 00 00 00 00 02 fb 01
					29 01 00 00 00 00 11 b0 00 00 00 2e 00 65 00 8c 00 aa 00 c4 00 da 00 ed
					29 01 00 00 00 00 11 b1 00 fe 01 36 01 5c 01 99 01 c3 02 03 02 33 02 34
					29 01 00 00 00 00 11 b2 02 64 02 98 02 c0 02 f1 03 10 03 47 03 53 03 64
					29 01 00 00 00 00 0d b3 03 76 03 8c 03 a6 03 c3 03 d9 03 ff
					29 01 00 00 00 00 11 b4 00 00 00 2e 00 65 00 8c 00 aa 00 c4 00 da 00 ed
					29 01 00 00 00 00 11 b5 00 fe 01 36 01 5c 01 99 01 c3 02 03 02 33 02 34
					29 01 00 00 00 00 11 b6 02 64 02 98 02 c0 02 f1 03 10 03 47 03 53 03 64
					29 01 00 00 00 00 0d b7 03 76 03 8c 03 a6 03 c3 03 d9 03 ff
					29 01 00 00 00 00 11 b8 00 00 00 2e 00 65 00 8c 00 aa 00 c4 00 da 00 ed
					29 01 00 00 00 00 11 b9 00 fe 01 36 01 5c 01 99 01 c3 02 03 02 33 02 34
					29 01 00 00 00 00 11 ba 02 64 02 98 02 c0 02 f1 03 10 03 47 03 53 03 64
					29 01 00 00 00 00 0d bb 03 76 03 8c 03 a6 03 c3 03 d9 03 ff
					15 01 00 00 00 00 02 ff 10
					15 01 00 00 00 00 02 fb 01
					15 01 00 00 00 00 02 ba 03
					05 01 00 00 96 00 02 11 00
					05 01 00 00 00 00 02 29 00
				];
				qcom,mdss-dsi-off-command = [
					05 01 00 00 32 00 02 28 00
					05 01 00 00 78 00 02 10 00
				];
				qcom,mdss-dsi-on-command-state = "dsi_lp_mode";
				qcom,mdss-dsi-off-command-state = "dsi_hs_mode";
				qcom,mdss-dsi-panel-phy-timings = <0x1f1b0506 0x30204a0 0x1f1b0506 0x30204a0 0x1f1b0506 0x30204a0 0x1f1b0506 0x30204a0 0x1f100406 0x30204a0>;
				qcom,display-topology = <1 0 1>;
				qcom,default-topology-index = <0>;
			};
		};
	};
};
