## kernel/Kconfig
```kconfig
# SPDX-License-Identifier: GPL-2.0-only
#
# Oplus kernel feature configuration

if OPLUS_KERNEL

config OPLUS_SYSTEM_KERNEL_QCOM
	bool "Qcom platform"
	default y if ARCH_QCOM
	default n
	help
	  Distinguish Qcom from other platforms so that Oplus kernel
	  features can select the correct platform specific paths.

source "kernel/sched_assist/Kconfig"

endif # OPLUS_KERNEL
```

## kernel/sched_assist/Kconfig
```kconfig
# SPDX-License-Identifier: GPL-2.0-only
# Copyright (C) 2020-2022 Oplus. All rights reserved.

config OPLUS_FEATURE_SCHED_ASSIST
	bool "sched_assist"
	default n
	help
	  Enable the Oplus scheduler assist framework for UX-critical
	  tasks. It tracks UX, render and top-app tasks, propagates UX
	  state through binder and runqueue inheritance, applies wakeup
	  preemption and execution-slice policy, and exposes debug
	  controls through /proc/oplus_scheduler/sched_assist/ and the
	  scene mask through /proc/sys/kernel/sched_assist_scene.

	  This is the main switch for the sched_assist options. If
	  unsure, say N.
```

## mm/kshrink_slabd/Kconfig
```kconfig
config KSHRINK_SLABD
	bool "Enable asynchronous slab shrinker daemon"
	default n
	help
	  Move slab shrinking out of the direct-reclaim path and into a
	  background kthread.  When direct reclaim wants to shrink slab
	  caches, it wakes kshrink_slabd instead of calling shrink_slab()
	  synchronously; the daemon runs the shrinker work on a CPU that
	  is not the highest-frequency CPU.

	  This can reduce allocation latency for the caller at the cost
	  of doing the slab reclaim asynchronously.  The daemon is
	  started at boot and only runs when woken.

	  Say Y here to enable the asynchronous slab shrinker daemon.
	  If unsure, say N.
```

## mm/multi_freearea/Kconfig
```kconfig
config PHYSICAL_ANTI_FRAGMENTATION
	bool "Physical memory anti-fragmentation"
	depends on !S390
	default y
	help
	  Split the buddy allocator free lists of each zone into four
	  free areas (FLCs) covering equal page frame ranges, and keep
	  the pages of every free list ordered by their physical
	  address.

	  Free pages are inserted into the area matching their PFN and
	  are kept sorted around the midpoint of that area.  For order
	  3 and above the free area index is mirrored, so allocation
	  preference runs from the opposite end of the zone.  This
	  keeps large contiguous blocks together and reduces physical
	  memory fragmentation on long-running devices.

	  Say Y here to enable physical memory anti-fragmentation.
	  If unsure, say Y.
```

## mm/proactive_compact/Kconfig
```kconfig
# SPDX-License-Identifier: GPL-2.0-only
# Copyright (C) 2020-2022 Oplus. All rights reserved.

config PROACTIVE_COMPACT
	tristate "Proactive compaction using a fragmentation index"
	default n
	help
	  Expose the external fragmentation of the first memory node
	  through /proc/oplus_mem/fragmentation_index.  Userspace can
	  read the index to decide whether compaction is needed and can
	  tune the target page order and proactiveness through the same
	  file or through the compaction_hpage_order and
	  compaction_proactiveness module parameters.

	  The index is the fragmentation for the configured page order,
	  weighted by zone size; a node is reported as fragmented when
	  the index exceeds the watermark derived from the proactiveness
	  value.

	  Say Y here to enable the fragmentation index interface.  If
	  unsure, say N.
```

## mm/reclaim_lessdelay/Kconfig
```kconfig
config SHRINK_LRU_TRYLOCK
	bool "Enable asynchronous LRU reclaim daemon"
	default n
	help
	  Reclaim pages that could not be locked by the normal LRU
	  shrinker on the first attempt asynchronously, instead of
	  blocking the caller or dropping the pages back to the LRU.

	  Pages whose trylock fails are collected on a private inactive
	  list (bounded to about 16MB) and a background kthread retries
	  reclaiming them on a CPU that is not the highest-frequency
	  CPU.  This reduces latency spikes caused by contended page
	  locks during direct reclaim.

	  Say Y here to enable the asynchronous LRU reclaim daemon.
	  If unsure, say N.
```
